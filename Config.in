## Config.in
```kconfig
source "$BR2_EXTERNAL/package/lincx/Config.in"
source "$BR2_EXTERNAL/package/xen/Config.in"
```

## configs/baredom_defconfig
```kconfig
BR2_x86_64=y
BR2_TOOLCHAIN_BUILDROOT_EGLIBC=y
BR2_EGLIBC_VERSION_2_19=y
BR2_BINUTILS_VERSION_2_24=y
BR2_GCC_VERSION_4_9_X=y
BR2_TARGET_GENERIC_HOSTNAME="baredom"
BR2_SYSTEM_BIN_SH_BASH=y
# BR2_TARGET_GENERIC_GETTY is not set
BR2_ROOTFS_POST_BUILD_SCRIPT="$(BR2_EXTERNAL)/post_build.sh"
BR2_LINUX_KERNEL=y
BR2_LINUX_KERNEL_USE_CUSTOM_CONFIG=y
BR2_LINUX_KERNEL_CUSTOM_CONFIG_FILE="$(BR2_EXTERNAL)/configs/linux.config"
BR2_PACKAGE_LINCX=y
BR2_PACKAGE_BUSYBOX_SHOW_OTHERS=y
BR2_PACKAGE_BINUTILS_TARGET=y
BR2_PACKAGE_BRIDGE_UTILS=y
BR2_PACKAGE_DHCPCD=y
BR2_PACKAGE_NANO=y
BR2_TARGET_ROOTFS_CPIO=y
BR2_TARGET_ROOTFS_CPIO_XZ=y
# BR2_TARGET_ROOTFS_TAR is not set
```

## package/lincx/Config.in
```kconfig
config BR2_PACKAGE_LINCX
	bool "lincx"
	select BR2_PACKAGE_XEN
	select BR2_PACKAGE_ERLANG
	select BR2_PACKAGE_BINUTILS
	help
		LINCX is a pure OpenFlow software switch written in Erlang.
		It runs within a separate domain under Xen hypervisor using LING.
```

## package/xen/Config.in
```kconfig
config BR2_PACKAGE_XEN
	bool "xen"
	select BR2_PACKAGE_UTIL_LINUX
	select BR2_PACKAGE_UTIL_LINUX_LIBUUID
	select BR2_PACKAGE_NCURSES
	select BR2_PACKAGE_LIBAIO
	select BR2_PACKAGE_OPENSSL
	select BR2_PACKAGE_YAJL
	select BR2_PACKAGE_LIBGLIB2
	select BR2_PACKAGE_PYTHON
	select BR2_PACKAGE_PIXMAN
	help
	  Xen hypervisor
```
